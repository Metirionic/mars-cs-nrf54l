## CMakeLists.txt
```
# SPDX-License-Identifier: MIT
cmake_minimum_required(VERSION 3.20.0)

list(APPEND BOARD_ROOT ${CMAKE_CURRENT_LIST_DIR}/..)

include(FetchContent)
FetchContent_Declare(
  mars-bluetooth-hci
  GIT_REPOSITORY https://github.com/Metirionic/mars-bluetooth-hci.git
  GIT_TAG mars-bluetooth-hci@0.13.2)
FetchContent_MakeAvailable(mars-bluetooth-hci)

set(MARS_BT_HCI_RUST_DIR ${mars-bluetooth-hci_SOURCE_DIR}/mars-bluetooth-hci)
set(RUST_TARGET "thumbv8m.main-none-eabihf")

list(APPEND CMAKE_PREFIX_PATH ${MARS_BT_HCI_RUST_DIR})
find_package(mars-bluetooth-hci-rust)
find_package(Zephyr REQUIRED HINTS $ENV{ZEPHYR_BASE})

project(initiator)

add_subdirectory(${CMAKE_CURRENT_LIST_DIR}/../common cs_common)

target_sources(app PRIVATE src/main.c src/serialize.c src/ras_worker.c
                           ${CMAKE_CURRENT_LIST_DIR}/../common/rust_callbacks.c)
target_include_directories(app PRIVATE src)
target_link_libraries(app PRIVATE cs_common)
target_include_directories(cs_common
                           PUBLIC ${MARS_BT_HCI_RUST_INCLUDE_DIRECTORIES})

add_dependencies(app build_mars_bt_hci_rust)
target_link_libraries(app PRIVATE ${MARS_BT_HCI_RUST_LINK_LIBRARIES})
```

## Kconfig
```
#
# Copyright (c) 2024 Nordic Semiconductor ASA
#
# SPDX-License-Identifier: MIT
#

menu "Mars Channel Sounding options"

config MARS_CS_INLINE_PCT
	bool "Enable inline Phase Correction Term Transfer (IPT) mode"
	depends on BT_CHANNEL_SOUNDING
	select BT_CTLR_EXTENDED_FEAT_SET
	help
	  Enable inline PCT (Phase Correction Term) transfer mode, mirroring
	  the Nordic ipt_* samples. The initiator uses only the local
	  le_cs_subevent_data_available results for distance estimation,
	  the reflector's PCT contribution is embedded in the received
	  tones, so the Ranging Service (RAS) GATT path is not used.

	  When enabled, this option is mutually exclusive with the RAS
	  Requestor/Responder roles (CONFIG_BT_RAS_RREQ / CONFIG_BT_RAS_RRSP),
	  which the application conf fragments set to n.

	  Note: inline PCT only applies to PBR (Main Mode 2). The CS
	  configuration is forced to BT_CONN_LE_CS_MAIN_MODE_2_NO_SUB_MODE
	  in this mode.

endmenu

source "Kconfig.zephyr"
```

## sample.yaml
```
sample:
  description: Bluetooth Low Energy Channel Sounding Initiator with Ranging Service Requester
  name: Bluetooth LE Channel Sounding Initiator with RREQ
tests:
  sample.bluetooth.channel_sounding_ras_initiator:
    sysbuild: true
    build_only: true
    integration_platforms:
      - nrf54l15dk/nrf54l05/cpuapp
      - nrf54l15dk/nrf54l10/cpuapp
      - nrf54l15dk/nrf54l15/cpuapp
    platform_allow:
      - nrf54l15dk/nrf54l05/cpuapp
      - nrf54l15dk/nrf54l10/cpuapp
      - nrf54l15dk/nrf54l15/cpuapp
    tags: bluetooth ci_build sysbuild
  sample.bluetooth.channel_sounding_ipt_initiator:
    sysbuild: true
    build_only: true
    integration_platforms:
      - nrf54l15dk/nrf54l15/cpuapp
    platform_allow:
      - nrf54l15dk/nrf54l15/cpuapp
    extra_configs:
      - CONFIG_MARS_CS_INLINE_PCT=y
      - CONFIG_BT_RAS_RREQ=n
    tags: bluetooth ci_build sysbuild
```

## prj.conf
```kconfig
#
# Copyright (c) 2024 Nordic Semiconductor ASA
#
# SPDX-License-Identifier: MIT
#

CONFIG_NCS_SAMPLES_DEFAULTS=y
CONFIG_DK_LIBRARY=y

CONFIG_BT=y
CONFIG_BT_SMP=y
CONFIG_BT_MAX_CONN=1
CONFIG_BT_BONDABLE=n

CONFIG_BT_GATT_CLIENT=y
CONFIG_BT_GATT_DYNAMIC_DB=y
CONFIG_BT_CENTRAL=y
CONFIG_BT_SCAN=y
CONFIG_BT_SCAN_FILTER_ENABLE=y
CONFIG_BT_SCAN_UUID_CNT=1

CONFIG_BT_CHANNEL_SOUNDING=y
CONFIG_BT_RAS=y
CONFIG_BT_RAS_RREQ=y

CONFIG_UART_ASYNC_API=y
# A UART driver device is required for the cobs-uart chosen node the COBS
# transport acquires in src/serialize.c (DEVICE_DT_GET(DT_CHOSEN(cobs_uart))).
# Enable the serial driver at the app level so every board preset gets it;
# the nrf54l15dk board defconfig already sets this.
CONFIG_SERIAL=y
CONFIG_NEWLIB_LIBC=y

# The Ranging Profile recommends a MTU of at least 247 octets.
CONFIG_BT_L2CAP_TX_MTU=498
CONFIG_BT_BUF_ACL_TX_SIZE=502
CONFIG_BT_BUF_ACL_RX_SIZE=502
CONFIG_BT_ATT_PREPARE_COUNT=3
CONFIG_BT_CTLR_DATA_LENGTH_MAX=251

# This reduces RAM usage. Additional RAM is needed to support optional
# features such as mode 3 or multiantenna. Change or remove these if
# using those features
CONFIG_BT_RAS_MODE_3_SUPPORTED=n
CONFIG_BT_CTLR_SDC_CS_STEP_MODE3=n

# This size assumes the largest step size is mode 2 with one antenna path:
# 12 bytes * 160 steps in a subevent. Change or remove this if using mode 3
# or multiantenna.
CONFIG_BT_CHANNEL_SOUNDING_REASSEMBLY_BUFFER_SIZE=4800

# This allows CS and ACL to use different PHYs
CONFIG_BT_TRANSMIT_POWER_CONTROL=y

# This improves the performance of floating-point operations
CONFIG_FPU=y
CONFIG_FPU_SHARING=y

CONFIG_HEAP_MEM_POOL_SIZE=32768
CONFIG_MAIN_STACK_SIZE=10000
CONFIG_CBPRINTF_FP_SUPPORT=y

CONFIG_BT_CS_DE=y
```

## central.overlay
```dts
# Makes the initiator a scanning central.

CONFIG_BT_CENTRAL=y

CONFIG_BT_SCAN=y
CONFIG_BT_SCAN_FILTER_ENABLE=y
CONFIG_BT_SCAN_UUID_CNT=1
```

## src/main.c
```c
/*
 * Copyright (c) 2024 Nordic Semiconductor ASA
 *
 * SPDX-License-Identifier: MIT
 */

/** @file
 *  @brief Channel Sounding initiator with ranging requester sample
 */

#include <stdio.h>
#include <zephyr/bluetooth/cs.h>
#include <zephyr/drivers/gpio.h>
#include <zephyr/kernel.h>
#include <zephyr/logging/log.h>
#include <zephyr/sys/reboot.h>

#if !defined(CONFIG_MARS_CS_INLINE_PCT)
#include <bluetooth/services/ras.h>
#endif

#include "addr_utils.h"
#include "antenna.h"
#include "ble_callbacks.h"
#include "cs_initiator.h"
#include "cs_watchdog.h"
#include "serialize.h"
#if IS_ENABLED(CONFIG_BT_RAS_RREQ)
#include "ras_worker.h"
#endif
#include "subevent.h"

LOG_MODULE_REGISTER(app_main, LOG_LEVEL_INF);

/** @brief Saved CS config from config creation callback (used for role in serialization). */
static struct bt_conn_le_cs_config cs_config;

#if IS_ENABLED(CONFIG_MARS_CS_INLINE_PCT)
/**
 * @brief Process populated subevent events by serializing them over UART COBS.
 *
 * Called on the main loop thread from cs_initiator_consume_pending_event(); the shared IPT skeleton populates the
 * events on the BT RX thread and hands them over. The blocking serialize + UART TX path must stay off the RX thread,
 * where it would delay the SDC's step-data delivery until the controller aborts the surplus subevents (#173 — numbers
 * in docs/architecture.md).
 */
static void process_subevent_cb(SubeventResultEvent_t * p_local_event, SubeventResultEvent_t * p_peer_event)
{
    /* CS liveness watchdog (#116): the skeleton hands over completed procedures with step data, and this thread
     * consumes them at the wire rate — so the pet paces at the consume rate, not the completion rate, and holds the
     * link while the wire keeps up (see #173). */
    cs_watchdog_pet();

    serialize_run(p_local_event, p_peer_event);
}
#else
/**
 * @brief Callback for ranging data received from peer (realtime or on-demand).
 *
 * Checks counter match, validates step data, populates SubeventResultEvents
 * via an owned snapshot queued to the main-loop worker. No UART waits run here.
 */
static void ranging_data_cb(struct bt_conn * p_conn, uint16_t ranging_counter, int err)
{
    ARG_UNUSED(p_conn);

    if (err)
    {
        LOG_ERR("Error when receiving ranging data with ranging counter %d (err %d)", ranging_counter, err);
        /* Fault-path diagnostic: make the stall trigger visible on the COBS
         * UART — the host's only window into the initiator. */
        char msg[64];

        snprintf(msg, sizeof(msg), "RD error: counter %u, err %d", ranging_counter, err);
        ras_worker_log(msg);

        /* Mirror the mismatch/aborted recovery below: the sem was taken at
         * the new-procedure gate in cs_initiator.c, and without this give
         * every subsequent procedure drops at the gate — the data path (and
         * COBS stream) stalls permanently (see #109). */
        net_buf_simple_reset(cs_initiator_get_local_steps());

        if (!(cs_initiator_get_ras_feature_bits() & RAS_FEAT_REALTIME_RD))
        {
            net_buf_simple_reset(cs_initiator_get_peer_steps());
        }

        cs_initiator_give_sem_local_steps();
        return;
    }

    int32_t local_ranging_counter = cs_initiator_get_local_ranging_counter();

    if (ranging_counter != local_ranging_counter)
    {
        LOG_INF(
            "Ranging data dropped as peer ranging counter doesn't match local ranging "
            "data counter. (peer: %u, local: %u)",
            ranging_counter,
            local_ranging_counter);

        char msg[64];

        snprintf(msg, sizeof(msg), "RD dropped: peer %u, local %u", ranging_counter, local_ranging_counter);
        ras_worker_log(msg);

        net_buf_simple_reset(cs_initiator_get_local_steps());

        if (!(cs_initiator_get_ras_feature_bits() & RAS_FEAT_REALTIME_RD))
        {
            net_buf_simple_reset(cs_initiator_get_peer_steps());
        }

        cs_initiator_give_sem_local_steps();
        return;
    }

    LOG_DBG("Ranging data received for ranging counter %d", ranging_counter);

    struct net_buf_simple * latest_local_steps = cs_initiator_get_local_steps();

    if (latest_local_steps->len == 0)
    {
        LOG_WRN("All subevents in ranging counter %u were aborted", local_ranging_counter);

        char msg[64];

        snprintf(msg, sizeof(msg), "All subevents aborted: counter %u", local_ranging_counter);
        ras_worker_log(msg);

        net_buf_simple_reset(latest_local_steps);
        cs_initiator_give_sem_local_steps();

        if (!(cs_initiator_get_ras_feature_bits() & RAS_FEAT_REALTIME_RD))
        {
            net_buf_simple_reset(cs_initiator_get_peer_steps());
        }
        return;
    }

    /* CS liveness watchdog (#116): this is the "completed procedure with step
     * data" signal. The len==0 branch above deliberately does NOT pet — during
     * the abort-storm RDs keep arriving at 5/s but never reach this point. */
    cs_watchdog_pet();

    size_t                           subevent_count;
    const struct cs_local_subevent * subevents = cs_initiator_get_subevents(&subevent_count);
    (void)ras_worker_submit(subevents,
                            subevent_count,
                            latest_local_steps,
                            cs_initiator_get_peer_steps(),
                            cs_initiator_get_local_mac(),
                            cs_initiator_get_peer_mac(),
                            cs_config.role);

    net_buf_simple_reset(latest_local_steps);

    if (!(cs_initiator_get_ras_feature_bits() & RAS_FEAT_REALTIME_RD))
    {
        net_buf_simple_reset(cs_initiator_get_peer_steps());
    }

    cs_initiator_give_sem_local_steps();
}

/** @brief Callback for RAS "data ready" — requests on-demand ranging data from peer. */
static void ranging_data_ready_cb(struct bt_conn * p_conn, uint16_t ranging_counter)
{
    LOG_DBG("Ranging data ready %i", ranging_counter);

    if (ranging_counter == cs_initiator_get_local_ranging_counter())
    {
        int err = bt_ras_rreq_cp_get_ranging_data(cs_initiator_get_connection(),
                                                  cs_initiator_get_peer_steps(),
                                                  ranging_counter,
                                                  ranging_data_cb);
        if (err)
        {
            LOG_ERR("Get ranging data failed (err %d)", err);
            net_buf_simple_reset(cs_initiator_get_local_steps());
            net_buf_simple_reset(cs_initiator_get_peer_steps());
            cs_initiator_give_sem_local_steps();
        }
    }
}
#endif /* CONFIG_MARS_CS_INLINE_PCT */

/** @brief Hook that saves the negotiated CS config for later use. */
static void config_create_hook(struct bt_conn_le_cs_config * config)
{
    cs_config = *config;
}

/** @brief Fallback reboot if the watchdog's forced disconnect never completes. */
static void reboot_fallback_handler(struct k_timer * timer)
{
    ARG_UNUSED(timer);

    sys_reboot(SYS_REBOOT_COLD);
}

static K_TIMER_DEFINE(reboot_fallback, reboot_fallback_handler, NULL);

/**
 * @brief CS liveness watchdog recovery (#116) — runs on the system workqueue.
 *
 * Emits a COBS banner (the host's only window into the initiator), then
 * forces a disconnect so the existing disconnected_cb -> sys_reboot path
 * recovers both boards. The 2 s fallback timer covers a wedged controller
 * that never completes the HCI disconnect command (bt_hci_disconnect has no
 * timeout); a failed disconnect means the link is already gone, so reboot.
 */
static void cs_watchdog_recovery_cb(void)
{
    (void)serialize_send_log_message("CS watchdog: no completed procedure, forcing disconnect");

    struct bt_conn * conn = ble_callbacks_get_connection();

    if (conn != NULL && bt_conn_disconnect(conn, BT_HCI_ERR_LOCALHOST_TERM_CONN) == 0)
    {
        k_timer_start(&reboot_fallback, K_MSEC(2000), K_NO_WAIT);
        return;
    }

    sys_reboot(SYS_REBOOT_COLD);
}

#define RF_SWITCH_SUPPLY_GPIO_NODE DT_NODELABEL(gpio2)
#define RF_SWITCH_SUPPLY_GPIO_PIN  5

int main(void)
{
    int err;


    const struct device * rf_switch_supply_gpio = DEVICE_DT_GET(RF_SWITCH_SUPPLY_GPIO_NODE);
    if (!device_is_ready(rf_switch_supply_gpio))
    {
        LOG_ERR("RF switch supply is not ready");
        return 0;
    }

    err = gpio_pin_configure(rf_switch_supply_gpio, RF_SWITCH_SUPPLY_GPIO_PIN, GPIO_OUTPUT_HIGH);
    if (err)
    {
        LOG_ERR("Failed to configure RF switch supply P2.%02d high (err %d)", RF_SWITCH_SUPPLY_GPIO_PIN, err);
        return 0;
    }

    LOG_INF("Starting Mars Channel Sounding Initiator");

    err = bt_enable(NULL);
    if (err)
    {
        LOG_ERR("Bluetooth init failed (err %d)", err);
        return 0;
    }

    /* CS liveness watchdog (#116): inert until the first completed procedure
     * with step data pets it, so the handshake never false-triggers it. */
    cs_watchdog_init(cs_watchdog_recovery_cb);

#if IS_ENABLED(CONFIG_MARS_CS_INLINE_PCT)
    cs_initiator_set_process_subevent_cb(process_subevent_cb);
#else
    cs_initiator_set_ranging_data_cb(ranging_data_cb);
    cs_initiator_set_ranging_data_ready_cb(ranging_data_ready_cb);
#endif
    cs_initiator_set_config_created_cb(config_create_hook);

    const struct cs_initiator_config config = {
        /* Procedure cadence applies to ALL builds (RAS + IPT): this is
         * intentional, not an IPT leak — the new cadence speeds up
         * measurements across every antenna configuration (see #41).
         * It supersedes the prior RAS-only defaults (procedure_phy=1M,
         * min/max_procedure_interval=20/50, max_procedure_len=1000); any
         * RAS fixture/calibration/range baseline assuming those must be
         * re-baselined. Values match the Nordic ras_initiator sample:
         * procedure_interval=10.
         * IPT timing is computed dynamically in cs_initiator_start from
         * the negotiated config. The RAS multi-subevent trial instead uses
         * 16 ms subevents and a 90 ms procedure budget; the connect-time
         * interval in ble_scanning.c is intentionally conservative and is
         * tightened after the capabilities exchange.
         */
        .cs_sync_phy            = BT_CONN_LE_CS_SYNC_1M_PHY,
        .procedure_phy          = BT_LE_CS_PROCEDURE_PHY_2M,
#if IS_ENABLED(CONFIG_BT_RAS_RREQ)
        /* Single-subevent trial; 9 connection events at 32.5 ms = 292.5 ms. */
        .min_procedure_interval = 9,
        .max_procedure_interval = 9,
#else
        .min_procedure_interval = 10,
        .max_procedure_interval = 10,
#endif
    };

    err = cs_initiator_start(&config);
    if (err)
    {
        LOG_ERR("CS initiator start failed (err %d)", err);
        return 0;
    }

    while (true)
    {
#if IS_ENABLED(CONFIG_MARS_CS_INLINE_PCT)
        /* IPT: this thread is the serialize consumer — this call runs the process callback on the next event pair the
         * skeleton handed over (see process_subevent_cb and docs/architecture.md for why this must stay off the BT RX
         * thread; #173). */
        cs_initiator_consume_pending_event();
#else
        ras_worker_process();
#endif
    }

    return 0;
}
```

## src/ras_worker.c
```c
/* SPDX-License-Identifier: MIT */
#include "ras_worker.h"

#if IS_ENABLED(CONFIG_BT_RAS_RREQ)
#include <stdio.h>
#include <string.h>
#include <zephyr/logging/log.h>

#include "serialize.h"
#include "subevent.h"

LOG_MODULE_DECLARE(app_main, LOG_LEVEL_INF);

/* A bounded snapshot lets Bluetooth receive while the worker parses and
 * serializes. Drop a whole new procedure if the slot is still owned. */
struct ras_procedure
{
    struct cs_local_subevent subevents[BT_RAS_MAX_STEPS_PER_PROCEDURE];
    uint8_t                  local_steps[LOCAL_PROCEDURE_MEM];
    uint8_t                  peer_steps[BT_RAS_PROCEDURE_MEM];
    size_t                   count;
    size_t                   local_len;
    size_t                   peer_len;
    uint64_t                 local_mac;
    uint64_t                 peer_mac;
    enum bt_conn_le_cs_role  role;
};

struct ras_work
{
    struct ras_procedure * procedure;
    char                   message[64];
};

K_MEM_SLAB_DEFINE(ras_procedures, sizeof(struct ras_procedure), 1, 8);
K_MSGQ_DEFINE(ras_work_queue, sizeof(struct ras_work), 8, 4);
static uint32_t backlog_drops;

bool ras_worker_submit(const struct cs_local_subevent * subevents,
                       size_t                           count,
                       const struct net_buf_simple *    local_steps,
                       const struct net_buf_simple *    peer_steps,
                       uint64_t                         local_mac,
                       uint64_t                         peer_mac,
                       enum bt_conn_le_cs_role          role)
{
    if (subevents == NULL || count == 0 || count > BT_RAS_MAX_STEPS_PER_PROCEDURE || local_steps == NULL ||
        peer_steps == NULL || local_steps->len > LOCAL_PROCEDURE_MEM || peer_steps->len > BT_RAS_PROCEDURE_MEM)
    {
        return false;
    }
    struct ras_procedure * procedure;
    if (k_mem_slab_alloc(&ras_procedures, (void **)&procedure, K_NO_WAIT) != 0)
    {
        backlog_drops++;
        if (backlog_drops == 1 || backlog_drops % 128 == 0)
        {
            LOG_WRN("RAS worker backlog: dropped %u whole procedures", backlog_drops);
        }
        return false;
    }
    procedure->count     = count;
    procedure->local_len = local_steps->len;
    procedure->peer_len  = peer_steps->len;
    procedure->local_mac = local_mac;
    procedure->peer_mac  = peer_mac;
    procedure->role      = role;
    memcpy(procedure->subevents, subevents, count * sizeof(*subevents));
    for (size_t i = 0; i < count; i++)
    {
        procedure->subevents[i].result.step_data_buf = NULL;
    }
    memcpy(procedure->local_steps, local_steps->data, local_steps->len);
    memcpy(procedure->peer_steps, peer_steps->data, peer_steps->len);
    const struct ras_work work = {.procedure = procedure};
    if (k_msgq_put(&ras_work_queue, &work, K_NO_WAIT) != 0)
    {
        k_mem_slab_free(&ras_procedures, procedure);
        LOG_WRN("RAS work queue full; dropping whole procedure");
        return false;
    }
    return true;
}

void ras_worker_log(const char * message)
{
    struct ras_work work = {0};
    snprintf(work.message, sizeof(work.message), "%s", message);
    if (k_msgq_put(&ras_work_queue, &work, K_NO_WAIT) != 0)
    {
        LOG_WRN("RAS work queue full; dropping diagnostic");
    }
}

void ras_worker_process(void)
{
    struct ras_work work;
    if (k_msgq_get(&ras_work_queue, &work, K_FOREVER) != 0)
    {
        return;
    }
    if (work.procedure == NULL)
    {
        (void)serialize_send_log_message(work.message);
        return;
    }
    struct ras_procedure * procedure = work.procedure;
    struct net_buf_simple  local, peer;
    net_buf_simple_init_with_data(&local, procedure->local_steps, procedure->local_len);
    net_buf_simple_init_with_data(&peer, procedure->peer_steps, procedure->peer_len);
    static SubeventResultEvent_t local_event, peer_event;
    if (!subevent_populate(&local_event,
                           &peer_event,
                           procedure->local_mac,
                           procedure->peer_mac,
                           procedure->subevents,
                           procedure->count,
                           &local,
                           &peer,
                           procedure->role,
                           serialize_run))
    {
        LOG_ERR("Could not decode all subevents for procedure %u",
                procedure->subevents[0].result.header.procedure_counter);
        (void)serialize_send_log_message("RAS subevent decode error");
    }
    k_mem_slab_free(&ras_procedures, procedure);
}
#endif
```

## src/ras_worker.h
```c
/* SPDX-License-Identifier: MIT */
#ifndef RAS_WORKER_H
#define RAS_WORKER_H

#include "cs_initiator.h"

struct cs_local_subevent;

/** Copy a complete RAS procedure into worker-owned storage without waiting.
 * Returns false on invalid input or backlog; never retains producer pointers.
 */
bool ras_worker_submit(const struct cs_local_subevent * subevents,
                       size_t                           count,
                       const struct net_buf_simple *    local_steps,
                       const struct net_buf_simple *    peer_steps,
                       uint64_t                         local_mac,
                       uint64_t                         peer_mac,
                       enum bt_conn_le_cs_role          role);

/** Queue a diagnostic without blocking the Bluetooth RX thread. */
void ras_worker_log(const char * message);

/** Wait for and process one work item on the main thread (including UART waits). */
void ras_worker_process(void);

#endif
```

## src/serialize.c
```c
/*
 * Copyright (c) 2024 Nordic Semiconductor ASA
 *
 * SPDX-License-Identifier: MIT
 */

/** @file
 *  @brief Channel Sounding data serializer
 */

#include "serialize.h"

#include <string.h>
#include <zephyr/drivers/uart.h>
#include <zephyr/logging/log.h>
#include <zephyr/sys/atomic.h>

#include "subevent.h"

LOG_MODULE_DECLARE(app_main, LOG_LEVEL_INF);

#include "mars_bluetooth_hci.h"

/** @brief Max COBS-serialized size of ONE SubeventResultEvent (160 steps).
 *
 * Sized for mars-bluetooth-hci 0.13.2: ModeRoleSpecificInfo serializes a
 * mode0 field (quality, RSSI, antenna, measured_freq_offset u16) on EVERY
 * step alongside the mode1/mode2 fields, so sizes now depend on values
 * (postcard varints: the freq offset is 1 B when 0, 3 B for the 0xC000
 * sentinel). Measured per-event COBS sizes (host harness, 160 steps):
 *   13,302 B  zeroed (lower bound)
 *   13,955 B  realistic FW population (real MACs, populated mode0 + mode2)
 *   13,968 B  worst case (every varint maximized)
 * 14,000 B keeps headroom over the measured worst case; g_serialized below
 * holds two events plus a log message plus ~1 KB margin. 0.8.0 was ~8,640
 * B/event with no mode1 field; 0.12.0 was 12,502 B/event zeroed.
 */
#define CHUNK_SIZE 14000u

/** @brief TX buffer for COBS-encoded serialized data. Leave margin for log messages. */
static uint8_t g_serialized[CHUNK_SIZE * 2u + 1000u];
/** @brief Total bytes written to g_serialized for the current run. */
static size_t g_total_written_size = 0u;
/** @brief UART device used for COBS output. */
static const struct device * gp_cobs_uart_dev = DEVICE_DT_GET(DT_CHOSEN(cobs_uart));

/** @brief UART TX-done gate: count 1 when no async TX is in progress.
 *
 * Taken before reusing g_serialized; given by the UART async callback on
 * UART_TX_DONE / UART_TX_ABORTED (and on uart_tx() error, since the TX never
 * started in that case). Mirrors the sem_local_steps "buffer available" pattern
 * in common/cs_initiator.c, keeping uart_tx from ever being called while a
 * previous transfer is still DMA-ing out of g_serialized.
 */
static K_SEM_DEFINE(sem_tx_done, 1, 1);

/** @brief One-time UART async init guard (callback registered on first TX). */
static bool g_uart_async_init_done;
/** Remains set until a complete transfer sends a delimiter and valid frames. */
static atomic_t g_tx_resync_pending;

/**
 * @brief Append data to the global UART TX buffer.
 *
 * @return 0 on success, -ENOMEM if the data would overflow the buffer.
 */
static int serialize_cb(void * p_data, size_t size)
{
    if (g_total_written_size + size >= sizeof(g_serialized))
    {
        LOG_ERR("Serialization buffer overflow: %u + %u >= %u", g_total_written_size, size, sizeof(g_serialized));
        return -ENOMEM;
    }
    memcpy(&g_serialized[g_total_written_size], p_data, size);
    g_total_written_size += size;
    return 0;
}

/** @brief Reset serialization state for a new run. */
static void serialize_init(void)
{
    g_total_written_size = 0u;
    if (atomic_get(&g_tx_resync_pending))
    {
        /* End the previous partial COBS frame before starting a new one. */
        g_serialized[g_total_written_size++] = 0;
    }
}

/**
 * @brief Serialize a log message and append to the global TX buffer.
 *
 * @return 0 on success, negative errno on error.
 */
static int serialize_append_log_message(const char * p_message)
{
    SerializedData_t result = serialize_log_message((int8_t const *)p_message, true);

    if (result.p_data != NULL && result.size != 0u)
    {
        int err = serialize_cb(result.p_data, result.size);
        drop_bin(result);
        return err;
    }

    drop_bin(result);
    return 0;
}

/**
 * @brief Serialize a SubeventResultEvent and append to the global TX buffer.
 *
 * @return 0 on success, negative errno on error.
 */
static int serialize_append_event(SubeventResultEvent_t * p_event)
{
    SerializedData_t result = serialize_subevent_result_event(p_event, true);

    if (result.p_data != NULL && result.size != 0u)
    {
        int err = serialize_cb(result.p_data, result.size);
        drop_bin(result);
        return err;
    }

    drop_bin(result);
    return 0;
}

/**
 * @brief UART async callback: signals TX completion to release sem_tx_done.
 *
 * TX-only path: only UART_TX_DONE and UART_TX_ABORTED are handled (RX events
 * are unused). k_sem_give() is ISR-safe, so the give from the UARTE ISR cannot
 * deadlock against the k_sem_take() performed in serialize_run() (BT RX
 * workqueue context). UART_TX_ABORTED is not expected in practice (no
 * hardware flow control on the COBS UART overlays and uart_tx() uses
 * SYS_FOREVER_MS), but is handled defensively so the gate never sticks.
 */
static void cobs_uart_async_cb(const struct device * p_dev, struct uart_event * p_evt, void * p_user_data)
{
    ARG_UNUSED(p_dev);
    ARG_UNUSED(p_user_data);

    switch (p_evt->type)
    {
    case UART_TX_DONE:
        atomic_set(&g_tx_resync_pending, p_evt->data.tx.len != g_total_written_size);
        k_sem_give(&sem_tx_done);
        break;
    case UART_TX_ABORTED:
        LOG_WRN("COBS UART TX aborted (%u bytes sent)", (unsigned)p_evt->data.tx.len);
        atomic_set(&g_tx_resync_pending, 1);
        k_sem_give(&sem_tx_done);
        break;
    default:
        /* RX events unused (TX-only path). */
        break;
    }
}

/**
 * @brief Register the async UART callback once, on first use.
 *
 * @return 0 on success, negative errno on error.
 */
static int serialize_uart_init(void)
{
    if (g_uart_async_init_done)
    {
        return 0;
    }

    if (!device_is_ready(gp_cobs_uart_dev))
    {
        LOG_ERR("COBS UART device not ready");
        return -ENODEV;
    }

    int cb_err = uart_callback_set(gp_cobs_uart_dev, cobs_uart_async_cb, NULL);
    if (cb_err)
    {
        LOG_ERR("uart_callback_set failed (err %d)", cb_err);
        return cb_err;
    }

    g_uart_async_init_done = true;
    return 0;
}

/**
 * @brief Replace the in-flight buffer with a single log frame and transmit.
 *
 * Called while the TX gate is held (from serialize_run's failure paths).
 * The buffer may hold an unusable partial frame, so it is reset before
 * appending the marker. Returns the uart_tx result: on success the UART ISR
 * releases the gate; on failure the caller must.
 */
static int serialize_send_log_message_locked(const char * p_message)
{
    serialize_init();
    (void)serialize_append_log_message(p_message);
    return uart_tx(gp_cobs_uart_dev, g_serialized, g_total_written_size, SYS_FOREVER_MS);
}


int serialize_send_log_message(const char * p_message)
{
    int err = serialize_uart_init();
    if (err)
    {
        return err;
    }

    /* Gate: same buffer-protection rule as serialize_run — do not reuse
     * g_serialized until the previous async TX completed. In the normal
     * fault case no transfer is in flight and this returns immediately.
     */
    k_sem_take(&sem_tx_done, K_FOREVER);

    serialize_init();

    err = serialize_append_log_message(p_message);
    if (err)
    {
        k_sem_give(&sem_tx_done);
        return err;
    }

    err = uart_tx(gp_cobs_uart_dev, g_serialized, g_total_written_size, SYS_FOREVER_MS);
    if (err)
    {
        /* TX never started: release the gate so the next run does not hang. */
        k_sem_give(&sem_tx_done);
    }

    return err;
}

/**
 * @brief Serialize populated SubeventResultEvents and transmit over UART.
 *
 * COBS-encodes two SubeventResultEvent structures (initiator + reflector)
 * via the Rust FFI and transmits the COBS-encoded binary over the configured
 * UART device. The events must already be populated (via subevent_populate
 * or subevent_populate_inline) before calling this function.
 *
 * @param p_local_event  Populated initiator SubeventResultEvent.
 * @param p_peer_event   Populated reflector SubeventResultEvent.
 */
void serialize_run(SubeventResultEvent_t * p_local_event, SubeventResultEvent_t * p_peer_event)
{
    if (serialize_uart_init())
    {
        return;
    }

    /* Gate: do not reuse g_serialized until the previous async TX completed.
     * In steady state the prior TX finishes ~1-16 ms before the next procedure
     * completes, so this returns immediately; under jitter it blocks only for
     * the brief overshoot, in the quiet gap before the next procedure's first
     * subevent. The sem is given by cobs_uart_async_cb() from the UARTE ISR.
     */
    k_sem_take(&sem_tx_done, K_FOREVER);

    serialize_init();

    LOG_INF("Run serialization for procedure %u", p_local_event->initial_meta.procedure_counter);

    int err;

    err = serialize_append_event(p_local_event);
    if (err)
    {
        LOG_ERR("Failed to serialize local event (err %d)", err);
        /* Fault-path diagnostic: the buffer holds a partial event frame
         * that would not decode on the host, so replace it with a standalone
         * log frame (e.g. the -12 overflow from a wire-format size mismatch).
         */
        if (serialize_send_log_message_locked("Serialize error: local event") < 0)
        {
            k_sem_give(&sem_tx_done);
        }
        return;
    }

    err = serialize_append_event(p_peer_event);
    if (err)
    {
        LOG_ERR("Failed to serialize peer event (err %d)", err);
        if (serialize_send_log_message_locked("Serialize error: peer event") < 0)
        {
            k_sem_give(&sem_tx_done);
        }
        return;
    }

    err = serialize_append_log_message("Processing finished");
    if (err)
    {
        LOG_ERR("Failed to serialize log (err %d)", err);
        if (serialize_send_log_message_locked("Serialize error: log") < 0)
        {
            k_sem_give(&sem_tx_done);
        }
        return;
    }

    err = uart_tx(gp_cobs_uart_dev, g_serialized, g_total_written_size, SYS_FOREVER_MS);

    LOG_INF("Sending %u bytes", g_total_written_size);

    if (err)
    {
        LOG_ERR("UART TX failed (err %d)", err);
        /* TX never started: the buffer still holds valid frames — append a
         * failure marker and retry once so the host sees the cause instead
         * of a silent gap. */
        (void)serialize_append_log_message("UART TX error");
        err = uart_tx(gp_cobs_uart_dev, g_serialized, g_total_written_size, SYS_FOREVER_MS);
        if (err)
        {
            /* Second failure: release the gate so the next run does not hang. */
            k_sem_give(&sem_tx_done);
        }
    }
}
```

## src/serialize.h
```c
/*
 * Copyright (c) 2024 Nordic Semiconductor ASA
 *
 * SPDX-License-Identifier: MIT
 */

#ifndef SERIALIZE_H__
#define SERIALIZE_H__

#include "mars_bluetooth_hci.h"

/**
 * @brief Serialize populated SubeventResultEvents and transmit over UART COBS.
 *
 * @param p_local_event  Populated initiator SubeventResultEvent.
 * @param p_peer_event   Populated reflector SubeventResultEvent.
 */
void serialize_run(SubeventResultEvent_t * p_local_event, SubeventResultEvent_t * p_peer_event);

/**
 * @brief Serialize a log message and transmit it over UART COBS.
 *
 * Fault-path diagnostic entry point for events outside serialize_run
 * (e.g. the ranging data error path): the stall trigger that stops the
 * event stream is emitted here so a host capturing only the COBS UART can
 * see it. Honors the same UART TX gate as serialize_run.
 *
 * @param p_message  NUL-terminated message.
 * @return 0 on success, negative errno on error.
 */
int serialize_send_log_message(const char * p_message);


#endif /* SERIALIZE_H__ */
```
