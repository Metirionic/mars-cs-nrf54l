/*
 * Copyright (c) 2025 Nordic Semiconductor ASA
 *
 * SPDX-License-Identifier: LicenseRef-Nordic-5-Clause
 */

#include "uart20_p1_13_p1_14.dtsi"

/ {
    chosen {
        cobs-uart = &uart20;
    };
};

/*
 * The nrf54l15tag base DTS ships no uart20 pinctrl (the tag board's default
 * console path is Segger RTT, not a fixed UART), so the COBS UART pins must
 * come from the overlay. Unlike the nRF54L15 DK, the TAG has no onboard
 * USB/UART bridge, so an external UART-to-USB adapter (e.g. FT232R) must be
 * wired to the COBS UART to read the ranging stream. The TAG exposes only this
 * one UART — there is no console/shell UART; console goes over Segger RTT via
 * the debug probe (see boards/nrf54l15tag.conf and docs/hardware.md). The
 * uart20 pinctrl (TX P1.13 / RX P1.14 -> external FT232R) and enable live in
 * the shared uart20_p1_13_p1_14.dtsi (also used by the Fanstel BM15C, which
 * routes the COBS UART to the same pins).
 */
/ {
	cs_antenna_switch: cs-antenna-config {
		status = "okay";
		compatible = "nordic,bt-cs-antenna-switch";
		ant-gpios = <&gpio1 9 GPIO_ACTIVE_HIGH>,
			    <&gpio1 10 GPIO_ACTIVE_HIGH>;
		multiplexing-mode = <0>;
	};
};

/* delete other nodes that drive the antenna pins so there is no duplicate access */
/delete-node/ &sky13348;

&gpio1 {
	/delete-node/ antenna_switch_v1;
	/delete-node/ antenna_switch_v2;
};
