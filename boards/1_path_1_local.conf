## boards/1_path_1_local.conf
```kconfig
CONFIG_BT_RAS_MAX_ANTENNA_PATHS=1
CONFIG_BT_CTLR_SDC_CS_MAX_ANTENNA_PATHS=1
CONFIG_BT_CTLR_SDC_CS_NUM_ANTENNAS=1
```

## boards/4_path_4_local.conf
```kconfig
CONFIG_BT_RAS_MAX_ANTENNA_PATHS=4
CONFIG_BT_CTLR_SDC_CS_MAX_ANTENNA_PATHS=4
CONFIG_BT_CTLR_SDC_CS_NUM_ANTENNAS=4
```

## boards/inline_pct_initiator.conf
```kconfig
# SPDX-License-Identifier: MIT
#
# Inline PCT (IPT) mode configuration fragment for the initiator.
#
# This file is appended via EXTRA_CONF_FILE to override the ras-style
# defaults from prj.conf / central.overlay. Zephyr applies EXTRA_CONF_FILE
# after CONF_FILE, so settings here take precedence.

# Enable inline PCT mode and the controller CS Enhancements it requires.
CONFIG_MARS_CS_INLINE_PCT=y

# RAS Ranging Service is not used in IPT mode.
CONFIG_BT_RAS=n
CONFIG_BT_RAS_RREQ=n
CONFIG_BT_RAS_MODE_3_SUPPORTED=n

# No GATT client / large MTU required: the reflector's PCT contribution is
# embedded in the local tones, so there is no RAS ranging-data transfer.
CONFIG_BT_GATT_CLIENT=n
CONFIG_BT_GATT_DYNAMIC_DB=n
CONFIG_BT_SCAN_UUID_CNT=0
CONFIG_BT_L2CAP_TX_MTU=498
CONFIG_BT_BUF_ACL_TX_SIZE=502
CONFIG_BT_BUF_ACL_RX_SIZE=502
CONFIG_BT_ATT_PREPARE_COUNT=3
CONFIG_BT_CTLR_DATA_LENGTH_MAX=251

# Discover the IPT reflector by advertised name instead of the Ranging Service
# UUID (the reflector does not advertise that UUID in IPT mode).
CONFIG_BT_SCAN_NAME_CNT=1
```

## boards/inline_pct_reflector.conf
```kconfig
# SPDX-License-Identifier: MIT
#
# Inline PCT (IPT) mode configuration fragment for the reflector.
#
# This file is appended via EXTRA_CONF_FILE to override the ras-style
# defaults from prj.conf. Zephyr applies EXTRA_CONF_FILE after CONF_FILE,
# so settings here take precedence.

# Enable inline PCT mode and the controller CS Enhancements it requires.
CONFIG_MARS_CS_INLINE_PCT=y
CONFIG_BT_CTLR_EXTENDED_FEAT_SET=y

# RAS Ranging Service responder is not used in IPT mode.
CONFIG_BT_RAS=n
CONFIG_BT_RAS_RRSP=n
CONFIG_BT_RAS_MODE_3_SUPPORTED=n

# Advertise the IPT reflector name so the initiator can discover it by name.
CONFIG_BT_DEVICE_NAME="Nordic CS IPT Reflector"
```

## boards/inline_pct_shared.conf
```kconfig
# SPDX-License-Identifier: MIT
#
# Shared Inline PCT (IPT) configuration fragment, applied to BOTH the
# initiator and reflector IPT builds via EXTRA_CONF_FILE.
#
# CONFIG_BT_DEVICE_NAME is the single source of truth for the IPT reflector's
# advertised name. The reflector advertises it (reflector/src/main.c); the
# initiator scans for it (common/ble_scanning.c). Rename here once and both
# sides update — there is no separately-typed C literal.
CONFIG_BT_DEVICE_NAME="Nordic CS IPT Reflector"
```

## boards/minew_me54be01.conf
```kconfig
# SPDX-License-Identifier: MIT

# Minewsemi ME54BE01 board console config. The ME54BE01 (ME54BS01-nRF54L15
# module) has a single UART — uart20, the COBS ranging stream (cobs-uart) —
# routed to the onboard USB-to-serial bridge over Type-C. There is no
# console/shell UART: the console (log output) runs over Segger RTT via an
# external J-Link debug probe (the ME54BE01 has no onboard debugger), matching
# the nrf54l15tag.conf pattern.
#
# Unlike the nrf54l15tag (whose defconfig sets neither UART_CONSOLE nor SERIAL),
# the ME54BE01 builds on the nrf54l15dk board defconfig, which sets both
# CONFIG_UART_CONSOLE=y and CONFIG_SERIAL=y. The overlay defines no
# zephyr,console chosen node (RTT console), so UART_CONSOLE must be explicitly
# disabled here — otherwise zephyr/drivers/console/uart_console.c references the
# missing zephyr,console node (DEVICE_DT_GET(DT_CHOSEN(zephyr_console))) and the
# build fails. CONFIG_SERIAL is left at its DK defconfig default (y); the
# uart20 cobs-uart device the initiator's serialize.c acquires still
# instantiates. These lines mirror Zephyr's rtt-console snippet
# (CONFIG_USE_SEGGER_RTT is the dependency CONFIG_RTT_CONSOLE requires).
CONFIG_USE_SEGGER_RTT=y
CONFIG_CONSOLE=y
CONFIG_RTT_CONSOLE=y
CONFIG_UART_CONSOLE=n
```

## boards/nrf54l15tag.conf
```kconfig
# SPDX-License-Identifier: MIT

# nRF54L15 TAG board console config. The TAG has a single UART (uart20, used
# for the COBS ranging stream via cobs-uart) and no onboard USB, so there is no
# console/shell UART: console, shell, mcumgr, bt-mon, and bt-c2h run over Segger
# RTT via the debug probe (J-Link through the DK DEBUG OUT header), matching
# Nordic's nrf54l15tag board guidance.
#
# CONFIG_SERIAL is app-level (set in initiator/prj.conf) — the initiator's COBS
# transport requires the cobs-uart device. The nrf54l15dk board defconfig provides
# CONFIG_UART_CONSOLE for the DK's UART console; the tag has no console UART, so
# UART_CONSOLE stays at its default (n) and the RTT backend is selected here.
# These lines mirror Zephyr's rtt-console snippet (CONFIG_USE_SEGGER_RTT is the
# dependency CONFIG_RTT_CONSOLE requires).
CONFIG_USE_SEGGER_RTT=y
CONFIG_CONSOLE=y
CONFIG_RTT_CONSOLE=y
```

## west.yml
```yaml
# West manifest for mars-cs-nrf54l
# Use with: west init -l . --mf west.yml && west update
manifest:
  version: "0.13"

  remotes:
    - name: ncs
      url-base: https://github.com/nrfconnect

  defaults:
    remote: ncs

  projects:
    - name: nrf
      repo-path: sdk-nrf
      revision: v3.3.0
      import: true

  self:
    path: mars-cs-nrf54l
```
