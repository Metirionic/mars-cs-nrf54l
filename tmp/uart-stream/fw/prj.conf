## CMakeLists.txt
```
# SPDX-License-Identifier: MIT
# Throwaway UART-only stream test for the #190 COBS corruption investigation.
cmake_minimum_required(VERSION 3.20.0)

# The board overlay lives in <app>/boards/, and Zephyr only searches
# <root>/boards/ for it -- so the app dir has to be a BOARD_ROOT, the same
# idiom initiator/CMakeLists.txt uses to reach the repo's boards/ dir. This
# must precede find_package(Zephyr): BOARD_ROOT is consumed while locating the
# board, and an app-root overlay is silently ignored.
list(APPEND BOARD_ROOT ${CMAKE_CURRENT_LIST_DIR})

find_package(Zephyr REQUIRED HINTS $ENV{ZEPHYR_BASE})
project(uart_stream)

target_sources(app PRIVATE src/main.c)
```

## Kconfig
```
# SPDX-License-Identifier: MIT
# Geometry of the UART stream test. Sweep these with -DCONFIG_... on the
# west build line: no source edits, one rebuild per configuration.

menu "UART stream test"

config STREAM_PAYLOAD_BYTES
	int "First event frame's payload bytes"
	default 13260
	help
	  Bytes of PRNG payload per event frame. The default gives a modal
	  13,316-byte COBS wire frame -- production's SubeventResultEvent frame
	  is 13,315/13,318 B -- so that two of them plus the 26-byte status
	  frame land on production's logged 26,658-byte uart_tx. The PRNG
	  payload makes the wire length jitter by roughly +/-10 B per frame
	  (production's zero-padded step arrays jitter by ~1 B).

config STREAM_DATA_FRAMES_PER_BURST
	int "Event frames per uart_tx (a status frame always follows)"
	default 2
	help
	  Production hands the UART one buffer per CS procedure holding TWO
	  SubeventResultEvent frames plus a small status frame -- 26,658 B in
	  one uart_tx. This is the event-frame count; a zero-payload status
	  frame is appended to every burst, so the burst is
	  DATA + 1 frames. 2 gives 13,316 + 13,316 + 26 = 26,658 B, matching
	  production's logged size; 1 isolates a single event frame per
	  transfer.

config STREAM_PAYLOAD_DELTA_B
	int "Second event frame's payload is this many bytes larger"
	default 3
	help
	  Production's two per-procedure event frames are not the same size
	  (13,315 and 13,318 wire bytes -- a 3-byte delta). Mirroring that keeps
	  the burst shape faithful and gives the size a 1-byte tuning knob.

config STREAM_STATUS_PAYLOAD
	int "Status frame payload bytes (fixed nonzero filler)"
	default 1
	help
	  The status frame carries this many bytes of a constant nonzero filler
	  rather than PRNG data, so its wire length moves exactly 1:1 with this
	  knob -- the fine adjustment that lands the burst total on production's
	  26,658. 1 is the tuned value for the default payload sizes.

config STREAM_ALT_PERIOD
	int "Bursts per traffic-pattern phase (0 = no alternation)"
	default 64
	help
	  Every this many bursts the firmware switches how it hands the same
	  bytes to the UART: phase 0 sends the whole burst in one uart_tx (as
	  production does per CS procedure), phase 1 sends one uart_tx per frame.
	  The status frame's payload byte carries the phase, so the host can
	  attribute each loss to the pattern in force at that moment -- one soak
	  then compares both patterns under identical bench conditions, which
	  separate runs cannot (the loss is episodic).

config STREAM_GAP_MS
	int "Idle gap between bursts (ms)"
	default 36
	help
	  Production runs ~89% duty at 921600 (289 ms of TX, ~36 ms idle, per
	  procedure). 36 mirrors it; 0 floods the line at 100%.

config STREAM_BURST_COUNT
	int "Total bursts to send (0 = infinite)"
	default 0

config STREAM_STATS_PERIOD_S
	int "Console stats line period in seconds (0 = silent)"
	default 0
	help
	  Console output shares the Interface MCU with the COBS stream (VCOM0
	  vs VCOM1 on the same probe). Silent by default so the baseline
	  capture is clean; set a period to run the "console chatter is a
	  confound" A/B.

endmenu

source "Kconfig.zephyr"
```

## prj.conf
```kconfig
# SPDX-License-Identifier: MIT
# UART-only stream test: no Bluetooth, no Rust serializer, no shell.
# The console stays on the DK default (uart30 -> VCOM0) so the COBS UART
# (uart20 -> VCOM1) is the only thing on the wire under test.

CONFIG_SERIAL=y
CONFIG_UART_ASYNC_API=y

# Zephyr's streaming COBS encoder (lib/utils/cobs.c) is gated on this; it also
# selects NET_BUF, which the cobs_encode()/cobs_decode() net_buf wrappers need.
CONFIG_COBS=y

CONFIG_LOG=y
# Mirror the production apps: minimal mode prints synchronously through printk
# to the console. The deferred log thread with the UART backend leaves
# LOG_BACKEND_UART_OUTPUT_DEFAULT=0, which swallows every message -- including
# the fatal-error report, so a faulting image looks like a silent hang.
CONFIG_LOG_MODE_MINIMAL=y

CONFIG_MAIN_STACK_SIZE=2048
```

## boards/nrf54l15dk_nrf54l15_cpuapp.overlay
```dts
/*
 * SPDX-License-Identifier: MIT
 *
 * Mirrors mars-cs-nrf54l/boards/nrf54l15dk_nrf54l15_cpuapp.overlay's UART half
 * exactly (the antenna-switch node is not needed here):
 *
 *  - uart20 is the production COBS UART (TX P1.04 / RX P1.05 -> Interface MCU
 *    -> VCOM1), acquired through the same chosen node production uses.
 *  - uart30 is the production console (-> VCOM0).
 *  - the DK's own dtsi leaves BOTH at 115200 and points zephyr,console at
 *    uart20, so without this file the stream leaves the nRF at 115200 while
 *    the Interface MCU reads 921600 and the console is wired to the wrong
 *    VCOM. Both must be overridden.
 */

/ {
	chosen {
		cobs-uart = &uart20;
		zephyr,console = &uart30;
		zephyr,shell-uart = &uart30;
		zephyr,uart-mcumgr = &uart30;
		zephyr,bt-mon-uart = &uart30;
		zephyr,bt-c2h-uart = &uart30;
	};
};

&uart30 {
	status = "okay";
	current-speed = <921600>;
};

&uart20 {
	status = "okay";
	current-speed = <921600>;
	/* 1 Mbps was measured 2026-10-14 (README matrix) on the Jun-2026 OB: broken,
	 * because that image's VCOM saturates at ~37 KB/s whatever the baud. The
	 * 2026-10-15 Jul-2025-OB run at 1 Mbps used the prebuilt app image kept at
	 * build/fw-1m. 921600 is the default because it mirrors production.
	 *
	 * 2026-10-11 firmware-matrix test (results in README.md): the Jun-11-2026
	 * OB firmware delivers this stream damaged at 921600 and 460800 (mid-frame
	 * corruption of long frames; frame heads arrive; short status frames parse)
	 * and perfectly at 115200. The Jul-8-2025 OB firmware delivers 921600
	 * 99.998% intact. 921600 stays the default: it mirrors production. */
};
```

## src/main.c
```c
/* SPDX-License-Identifier: MIT */
/*
 * [DEBUG-ust1] UART-only stream test for the #190 COBS corruption hunt.
 *
 * Streams COBS frames carrying a sequence number, the device's own cumulative
 * wire-byte count, an uptime stamp, a payload the host can regenerate from the
 * sequence number alone, and a CRC32 -- over uart20, the production COBS UART
 * (P1.04 -> onboard Interface MCU -> VCOM1). No Bluetooth, no Rust serializer,
 * no CS: the UART path is the only thing under test.
 *
 * The burst geometry mirrors production: one uart_tx() of N concatenated COBS
 * frames, then an idle gap (~89% duty at 921600). See Kconfig for the knobs.
 *
 * Wire format of one frame, after COBS encoding, with a 0x00 delimiter:
 *
 *   off  size field         notes
 *   0    4    magic         'M','S','T','1' (0x4D535431, little-endian bytes)
 *   4    1    version       1
 *   5    1    flags         BIT(0) first frame of burst, BIT(1) last
 *   6    4    seq           frame sequence, starts at 1
 *   10   2    frame_len     total DECODED length, header + payload + crc
 *   12   8    sent_total    wire bytes handed to uart_tx BEFORE this frame
 *   20   N    payload       PRNG stream seeded by seq (host regenerates)
 *   ..   4    crc32         zlib/IEEE-802.3 CRC of all preceding frame bytes
 *
 * Every byte of a frame is a pure function of (seq, payload bytes), so the host
 * regenerates the exact expected wire stream from the capture's own frame_len
 * and burst flags and can diff it byte-for-byte. A device-side timestamp field
 * would break that (COBS expansion depends on where a field's zero bytes land,
 * so a never-received frame's wire length would be unknown).
 *
 * Remove with the whole tmp/uart-stream directory.
 */

#include <errno.h>
#include <string.h>

#include <zephyr/data/cobs.h>
#include <zephyr/device.h>
#include <zephyr/drivers/uart.h>
#include <zephyr/kernel.h>
#include <zephyr/logging/log.h>

LOG_MODULE_REGISTER(ustream, LOG_LEVEL_INF);

#define MAGIC          0x4D535431u /* "MST1" */
#define VERSION        1u
#define HDR_LEN        20u
#define CRC_LEN        4u
/** Largest DECODED frame any burst can produce: the second event frame is
 *  PAYLOAD_DELTA_B bytes longer than the first, so frame_buf must be sized for
 *  that one, not for the base payload. Sizing it for the base let build_frame
 *  write 3 bytes past the end of frame_buf, which corrupted the following
 *  frames on the wire without any fault -- the buffer is the hard bound.
 */
#define FRAME_LEN      (HDR_LEN + CONFIG_STREAM_PAYLOAD_BYTES + \
                        CONFIG_STREAM_PAYLOAD_DELTA_B + CRC_LEN)
/** Frames per uart_tx: the configured event frames plus one status frame. */
#define BURST_FRAMES   (CONFIG_STREAM_DATA_FRAMES_PER_BURST + 1)
/** Decoded length of the status frame (header + filler + CRC). */
#define STATUS_FRAME_LEN (HDR_LEN + CONFIG_STREAM_STATUS_PAYLOAD + CRC_LEN)
/** Status frames carry a constant nonzero filler, so their wire length moves
 *  exactly 1:1 with CONFIG_STREAM_STATUS_PAYLOAD -- no PRNG zero-run jitter.
 */
#define STATUS_FILLER 0xA5u

#define FLAG_BURST_FIRST BIT(0)
#define FLAG_BURST_LAST  BIT(1)
#define FLAG_STATUS      BIT(2) /* the small status frame that ends a burst */

/** Worst-case COBS wire length: the bound Zephyr's cobs_max_encoded_len()
 *  computes (n + n/254 + 1) plus the trailing delimiter. A macro rather than
 *  that function because a static array bound needs a constant expression; the
 *  encoder sink enforces the capacity anyway, so an undersized buffer fails
 *  loudly (-ENOMEM) instead of corrupting memory.
 */
#define COBS_WIRE_MAX(n) ((n) + (n) / 254u + 2u)

#define BURST_CAP (CONFIG_STREAM_DATA_FRAMES_PER_BURST * COBS_WIRE_MAX(FRAME_LEN) + \
                   COBS_WIRE_MAX(STATUS_FRAME_LEN))

BUILD_ASSERT(CONFIG_STREAM_PAYLOAD_BYTES > 0, "payload must be non-empty");
BUILD_ASSERT(CONFIG_STREAM_DATA_FRAMES_PER_BURST > 0,
             "a burst needs at least one event frame");
BUILD_ASSERT(STATUS_FRAME_LEN <= FRAME_LEN, "frame_buf must hold the status frame too");
BUILD_ASSERT(BURST_FRAMES <= 4u, "burst_cap sizing below assumes at most 4 frames");

static const struct device *const gp_uart = DEVICE_DT_GET(DT_CHOSEN(cobs_uart));

/** TX-completion gate, given by the UART callback. Starts at 0: the loop
 *  waits on it *after* uart_tx() rather than before, so the wait is always for
 *  a transfer that is actually in flight and the buffer is never reused while
 *  the UARTE is still DMA-ing out of it.
 */
static K_SEM_DEFINE(sem_tx_done, 0, 1);

static uint8_t burst_buf[BURST_CAP];
static uint8_t frame_buf[FRAME_LEN];

static uint32_t crc_table[256];
static uint64_t sent_total; /* wire bytes handed to uart_tx so far */
static uint32_t seq_next = 1u;

/* ------------------------------------------------------------------ */
/* CRC32 (IEEE 802.3, reflected, init/final 0xFFFFFFFF) = zlib.crc32  */
/* ------------------------------------------------------------------ */

static void crc_table_init(void)
{
	for (uint32_t i = 0; i < 256u; i++)
	{
		uint32_t c = i;

		for (int k = 0; k < 8; k++)
		{
			c = (c & 1u) ? (0xEDB88320u ^ (c >> 1)) : (c >> 1);
		}
		crc_table[i] = c;
	}
}

static uint32_t crc32_ieee(const uint8_t * p, size_t n)
{
	uint32_t crc = 0xFFFFFFFFu;

	for (size_t i = 0; i < n; i++)
	{
		crc = crc_table[(crc ^ p[i]) & 0xFFu] ^ (crc >> 8);
	}

	return crc ^ 0xFFFFFFFFu;
}

/* ------------------------------------------------------------------ */
/* Payload generation -- the host mirrors this exactly                */
/* ------------------------------------------------------------------ */

static uint32_t prng_seed(uint32_t seq)
{
	return 0x9E3779B9u ^ (seq * 0x85EBCA6Bu);
}

static uint32_t xorshift32(uint32_t s)
{
	s ^= s << 13;
	s ^= s >> 17;
	s ^= s << 5;
	return s;
}

/** @brief Fill a payload.
 *
 * @param filler  0: the PRNG stream seeded by @p seq (event frames).
 *                Non-zero: that constant byte repeated (status frames), so the
 *                frame's wire length is a step function of its length alone.
 */
static void payload_fill(uint8_t * p_dst, size_t n, uint32_t seq, uint8_t filler)
{
	if (filler != 0u)
	{
		memset(p_dst, filler, n);
		return;
	}

	uint32_t state = prng_seed(seq);
	uint32_t word = 0u;

	for (size_t i = 0u; i < n; i++)
	{
		if ((i & 3u) == 0u)
		{
			state = xorshift32(state);
			word = state;
		}
		p_dst[i] = (uint8_t)(word >> (8u * (i & 3u)));
	}
}

static void put_u16(uint8_t * p, uint16_t v)
{
	p[0] = (uint8_t)(v & 0xFFu);
	p[1] = (uint8_t)((v >> 8) & 0xFFu);
}

static void put_u32(uint8_t * p, uint32_t v)
{
	for (int i = 0; i < 4; i++)
	{
		p[i] = (uint8_t)((v >> (8 * i)) & 0xFFu);
	}
}

static void put_u64(uint8_t * p, uint64_t v)
{
	for (int i = 0; i < 8; i++)
	{
		p[i] = (uint8_t)((v >> (8 * i)) & 0xFFu);
	}
}

/** @brief Render the decoded frame for @p seq into frame_buf.
 *
 * @param payload_n  payload bytes; 0 for the status frame, which is header,
 *                   CRC and nothing else.
 */
static void build_frame(uint32_t seq, uint8_t flags, size_t payload_n, uint8_t filler)
{
	size_t frame_len = HDR_LEN + payload_n + CRC_LEN;

	__ASSERT(frame_len <= sizeof(frame_buf), "frame_len %u exceeds frame_buf %u",
	         (unsigned)frame_len, (unsigned)sizeof(frame_buf));

	put_u32(&frame_buf[0], MAGIC);
	frame_buf[4] = (uint8_t)VERSION;
	frame_buf[5] = flags;
	put_u32(&frame_buf[6], seq);
	put_u16(&frame_buf[10], (uint16_t)frame_len);
	put_u64(&frame_buf[12], sent_total);

	payload_fill(&frame_buf[HDR_LEN], payload_n, seq, filler);

	put_u32(&frame_buf[frame_len - CRC_LEN], crc32_ieee(frame_buf, frame_len - CRC_LEN));
}

/* ------------------------------------------------------------------ */
/* COBS encoding                                                      */
/* ------------------------------------------------------------------ */

struct cobs_out
{
	size_t len; /* bytes already in burst_buf; sink appends from here */
};

static int cobs_sink(const uint8_t * p_buf, size_t len, void * p_user_data)
{
	struct cobs_out * p_out = p_user_data;

	if (p_out->len + len > sizeof(burst_buf))
	{
		return -ENOMEM;
	}

	memcpy(&burst_buf[p_out->len], p_buf, len);
	p_out->len += len;
	return 0;
}

/** @brief COBS-encode the frame in frame_buf onto the end of burst_buf.
 *
 * @param p_fill  in: burst_buf bytes already used; out: bytes used after.
 */
static int burst_append_frame(uint32_t seq, uint8_t flags, size_t payload_n, uint8_t filler,
                              size_t * p_fill)
{
	build_frame(seq, flags, payload_n, filler);
	size_t frame_len = HDR_LEN + payload_n + CRC_LEN;

	struct cobs_out out = { .len = *p_fill };
	struct cobs_encoder enc;
	int err;

	err = cobs_encoder_init(&enc, cobs_sink, &out, COBS_FLAG_TRAILING_DELIMITER);
	if (err)
	{
		LOG_ERR("cobs_encoder_init: %d", err);
		return err;
	}

	err = cobs_encoder_write(&enc, frame_buf, frame_len);
	if (err < 0)
	{
		LOG_ERR("cobs_encoder_write: %d", err);
		return err;
	}
	if ((size_t)err != frame_len)
	{
		LOG_ERR("cobs_encoder_write consumed %d of %u bytes", err, (unsigned)frame_len);
		return -EIO;
	}

	err = cobs_encoder_close(&enc);
	if (err)
	{
		LOG_ERR("cobs_encoder_close: %d", err);
		return err;
	}

	*p_fill = out.len;
	return 0;
}

/* ------------------------------------------------------------------ */
/* UART                                                               */
/* ------------------------------------------------------------------ */

static void uart_async_cb(const struct device * p_dev, struct uart_event * p_evt, void * p_user_data)
{
	ARG_UNUSED(p_dev);
	ARG_UNUSED(p_user_data);

	switch (p_evt->type)
	{
	case UART_TX_DONE:
		k_sem_give(&sem_tx_done);
		break;
	case UART_TX_ABORTED:
		LOG_WRN("uart20 TX aborted (%u bytes)", (unsigned)p_evt->data.tx.len);
		k_sem_give(&sem_tx_done);
		break;
	default:
		break;
	}
}

int main(void)
{
	if (!device_is_ready(gp_uart))
	{
		LOG_ERR("uart20 (cobs-uart) not ready");
		return -ENODEV;
	}

	int err = uart_callback_set(gp_uart, uart_async_cb, NULL);
	if (err)
	{
		LOG_ERR("uart_callback_set: %d", err);
		return err;
	}

	crc_table_init();

	LOG_INF("[DEBUG-ust1] uart-stream payload=%u+%u frame=%u status=%u data/burst=%u gap=%ums",
	        (unsigned)CONFIG_STREAM_PAYLOAD_BYTES, (unsigned)CONFIG_STREAM_PAYLOAD_DELTA_B,
	        (unsigned)FRAME_LEN, (unsigned)STATUS_FRAME_LEN,
	        (unsigned)CONFIG_STREAM_DATA_FRAMES_PER_BURST, (unsigned)CONFIG_STREAM_GAP_MS);

	uint32_t bursts = 0u;
	uint32_t frames = 0u;
	int64_t t_stats = k_uptime_get();

	while ((CONFIG_STREAM_BURST_COUNT == 0) || (bursts < (uint32_t)CONFIG_STREAM_BURST_COUNT))
	{
		size_t fill = 0u;
		size_t frame_off[BURST_FRAMES];
		size_t frame_len_bytes[BURST_FRAMES];

		/* Traffic-pattern phase: 0 = one uart_tx per burst (production's
		 * shape), 1 = one uart_tx per frame. Alternating within a single
		 * run is the only way to compare them: the loss comes in episodes,
		 * so two runs at different times cannot be compared.
		 */
		uint32_t phase = 0u;
		if (CONFIG_STREAM_ALT_PERIOD > 0)
		{
			phase = (bursts / (uint32_t)CONFIG_STREAM_ALT_PERIOD) % 2u;
		}

		for (uint32_t i = 0u; i < (uint32_t)BURST_FRAMES; i++)
		{
			bool is_status = (i == (uint32_t)CONFIG_STREAM_DATA_FRAMES_PER_BURST);
			uint8_t flags = 0u;
			size_t before = fill;

			if (i == 0u)
			{
				flags |= FLAG_BURST_FIRST;
			}
			if (is_status)
			{
				/* Production ends each CS procedure's transfer with a
				 * small status frame; mine carries the burst's own
				 * accounting and no payload.
				 */
				flags |= FLAG_BURST_LAST | FLAG_STATUS;
			}

			/* build_frame() stamps this frame with sent_total as it
			 * stands now, i.e. the wire bytes of every earlier frame;
			 * only then does this frame's own wire length count.
			 */
			/* Second event frame is larger, as in production. */
			size_t payload_n = CONFIG_STREAM_PAYLOAD_BYTES;
			uint8_t filler = 0u;

			if (is_status)
			{
				/* The status payload is the phase marker, not a constant
				 * filler: phase+1 keeps it non-zero (so the frame's wire
				 * length is unchanged) while telling the host which
				 * traffic pattern was in force.
				 */
				payload_n = CONFIG_STREAM_STATUS_PAYLOAD;
				if (payload_n > 0u)
				{
					filler = (uint8_t)(phase + 1u);
				}
			}
			else if (i == 1u)
			{
				payload_n += CONFIG_STREAM_PAYLOAD_DELTA_B;
			}

			frame_off[i] = fill;
			err = burst_append_frame(seq_next, flags, payload_n, filler, &fill);
			frame_len_bytes[i] = fill - frame_off[i];
			if (err)
			{
				LOG_ERR("burst_append_frame(seq %u): %d", seq_next, err);
				k_sem_give(&sem_tx_done);
				return err;
			}

			sent_total += (fill - before);
			seq_next++;
		}

		/* Started once per iteration and waited for once per iteration, so
		 * the semaphore is never over- or under-taken. (An earlier version
		 * took it both before building and after transmitting, which left
		 * the next iteration blocking forever -- one burst per boot.)
		 */
		/* All frames are built first either way, so the only thing that
		 * differs between the phases is the transfer granularity -- not the
		 * build timing.
		 */
		if (phase == 0u)
		{
			err = uart_tx(gp_uart, burst_buf, fill, SYS_FOREVER_MS);
			if (err)
			{
				LOG_ERR("uart_tx(%u): %d", (unsigned)fill, err);
			}
			else
			{
				k_sem_take(&sem_tx_done, K_FOREVER);
			}
		}
		else
		{
			for (uint32_t i = 0u; i < (uint32_t)BURST_FRAMES; i++)
			{
				err = uart_tx(gp_uart, &burst_buf[frame_off[i]], frame_len_bytes[i],
				              SYS_FOREVER_MS);
				if (err)
				{
					LOG_ERR("uart_tx[%u](%u): %d", i, (unsigned)frame_len_bytes[i], err);
					break;
				}
				k_sem_take(&sem_tx_done, K_FOREVER);
			}
		}

		bursts++;
		frames += (uint32_t)BURST_FRAMES;

		/* The idle gap belongs AFTER the transfer, not alongside it: sleeping
		 * while the UARTE is still shifting bytes just overlaps the two and
		 * the line never goes quiet, which ran this test at ~99% duty where
		 * production runs 89%.
		 */
		if (CONFIG_STREAM_GAP_MS > 0)
		{
			k_msleep(CONFIG_STREAM_GAP_MS);
		}

		if ((CONFIG_STREAM_STATS_PERIOD_S > 0) &&
		    (k_uptime_get() - t_stats >= (int64_t)CONFIG_STREAM_STATS_PERIOD_S * 1000))
		{
			t_stats = k_uptime_get();
			LOG_INF("[DEBUG-ust1] bursts=%u frames=%u wire=%llu", bursts, frames,
			        (unsigned long long)sent_total);
		}
	}

	LOG_INF("[DEBUG-ust1] done: bursts=%u frames=%u wire=%llu", bursts, frames,
	        (unsigned long long)sent_total);
	return 0;
}
```
