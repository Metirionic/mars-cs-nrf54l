## CMakeLists.txt
```
# SPDX-License-Identifier: MIT
cmake_minimum_required(VERSION 3.20.0)
list(APPEND BOARD_ROOT ${CMAKE_CURRENT_LIST_DIR})
find_package(Zephyr REQUIRED HINTS $ENV{ZEPHYR_BASE})
project(ustream_probe)
target_sources(app PRIVATE src/main.c)
```

## prj.conf
```kconfig
# Same console/log setup as the stream test, nothing else.
CONFIG_SERIAL=y
CONFIG_UART_ASYNC_API=y
CONFIG_LOG=y
CONFIG_LOG_MODE_MINIMAL=y
```

## boards/nrf54l15dk_nrf54l15_cpuapp.overlay
```dts
/*
 * SPDX-License-Identifier: MIT
 *
 * Mirrors mars-cs-nrf54l/boards/nrf54l15dk_nrf54l15_cpuapp.overlay's UART half
 * exactly (the antenna-switch node is not needed here):
 *
 *  - uart20 is the production COBS UART (TX P1.04 / RX P1.05 -> Interface MCU
 *    -> VCOM1), acquired through the same chosen node production uses.
 *  - uart30 is the production console (-> VCOM0).
 *  - the DK's own dtsi leaves BOTH at 115200 and points zephyr,console at
 *    uart20, so without this file the stream leaves the nRF at 115200 while
 *    the Interface MCU reads 921600 and the console is wired to the wrong
 *    VCOM. Both must be overridden.
 */

/ {
	chosen {
		cobs-uart = &uart20;
		zephyr,console = &uart30;
		zephyr,shell-uart = &uart30;
		zephyr,uart-mcumgr = &uart30;
		zephyr,bt-mon-uart = &uart30;
		zephyr,bt-c2h-uart = &uart30;
	};
};

&uart30 {
	status = "okay";
	current-speed = <921600>;
};

&uart20 {
	status = "okay";
	current-speed = <921600>;
};
```

## src/main.c
```c
/* SPDX-License-Identifier: MIT
 * [DEBUG-ust1] Does a freshly-rewritten TX buffer survive EasyDMA?
 *
 * Phase A: fill 0x41 once at boot, then burst 39,950 B every 36 ms.
 * Phase B: refill 0x42 immediately before each burst, same cadence.
 * If A arrives and B does not, the CPU data cache is not coherent with
 * EasyDMA -- and any firmware that serializes into a buffer and transmits it
 * straight away (initiator/src/serialize.c included) feeds the UART stale RAM.
 */
#include <zephyr/device.h>
#include <zephyr/drivers/uart.h>
#include <zephyr/kernel.h>

static const struct device *const u20 = DEVICE_DT_GET(DT_NODELABEL(uart20));
static K_SEM_DEFINE(done, 0, 1);
static uint8_t buf[40000];

static void cb(const struct device *dev, struct uart_event *evt, void *ud)
{
	ARG_UNUSED(dev); ARG_UNUSED(ud);
	if (evt->type == UART_TX_DONE || evt->type == UART_TX_ABORTED) {
		k_sem_give(&done);
	}
}

static void phase(const char *name, uint8_t fill)
{
	printk("[DEBUG-ust1] PHASE %s start\n", name);
	for (int i = 0; i < 20; i++) {
		if (fill) {
			for (size_t k = 0; k < sizeof(buf); k++) {
				buf[k] = fill;
			}
		}
		k_sem_reset(&done);
		if (uart_tx(u20, buf, sizeof(buf), SYS_FOREVER_MS)) {
			printk("[DEBUG-ust1] tx err\n");
			return;
		}
		k_sem_take(&done, K_FOREVER);
		k_msleep(36);
	}
	printk("[DEBUG-ust1] PHASE %s end\n", name);
}

int main(void)
{
	printk("[DEBUG-ust1] cache probe boot\n");
	printk("[DEBUG-ust1] cb reg=%d\n", uart_callback_set(u20, cb, NULL));

	for (size_t k = 0; k < sizeof(buf); k++) {
		buf[k] = 0x41;
	}
	phase("A-static", 0);
	k_msleep(1000);
	phase("B-rewrite-each", 0x42);
	k_msleep(1000);
	printk("[DEBUG-ust1] probe done\n");
	return 0;
}
```
