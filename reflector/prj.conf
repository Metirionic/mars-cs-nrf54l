## CMakeLists.txt
```
# SPDX-License-Identifier: MIT
cmake_minimum_required(VERSION 3.20.0)

list(APPEND BOARD_ROOT ${CMAKE_CURRENT_LIST_DIR}/..)

find_package(Zephyr REQUIRED HINTS $ENV{ZEPHYR_BASE})
project(channel_sounding_ras_reflector)

target_sources(
  app PRIVATE src/main.c src/location.c ${CMAKE_CURRENT_LIST_DIR}/../common/antenna.c
              ${CMAKE_CURRENT_LIST_DIR}/../common/cs_watchdog.c)
target_include_directories(app PRIVATE src ${CMAKE_CURRENT_LIST_DIR}/../common)
```

## Kconfig
```
#
# Copyright (c) 2024 Nordic Semiconductor ASA
#
# SPDX-License-Identifier: MIT
#

source "$(APPLICATION_SOURCE_DIR)/../common/Kconfig"

source "Kconfig.zephyr"
```

## sample.yaml
```
sample:
  description: Bluetooth Low Energy Channel Sounding Reflector with Ranging Service Responder
  name: Bluetooth LE Channel Sounding Reflector with RRSP
tests:
  sample.bluetooth.channel_sounding_ras_reflector:
    sysbuild: true
    build_only: true
    integration_platforms:
      - nrf54l15dk/nrf54l05/cpuapp
      - nrf54l15dk/nrf54l10/cpuapp
      - nrf54l15dk/nrf54l15/cpuapp
    platform_allow:
      - nrf54l15dk/nrf54l05/cpuapp
      - nrf54l15dk/nrf54l10/cpuapp
      - nrf54l15dk/nrf54l15/cpuapp
    tags: bluetooth ci_build sysbuild
  sample.bluetooth.channel_sounding_ipt_reflector:
    sysbuild: true
    build_only: true
    integration_platforms:
      - nrf54l15dk/nrf54l15/cpuapp
    platform_allow:
      - nrf54l15dk/nrf54l15/cpuapp
    extra_configs:
      - CONFIG_MARS_CS_INLINE_PCT=y
      - CONFIG_BT_RAS_RRSP=n
    tags: bluetooth ci_build sysbuild
```

## prj.conf
```kconfig
#
# Copyright (c) 2024 Nordic Semiconductor ASA
#
# SPDX-License-Identifier: MIT
#

CONFIG_NCS_SAMPLES_DEFAULTS=y
CONFIG_DK_LIBRARY=y

CONFIG_BT=y
CONFIG_BT_PERIPHERAL=y
CONFIG_BT_SMP=y
CONFIG_BT_DEVICE_NAME="Nordic CS Reflector"
CONFIG_BT_MAX_CONN=1
CONFIG_BT_GAP_AUTO_UPDATE_CONN_PARAMS=n
CONFIG_BT_BONDABLE=n

# Persist the reflector's writable X/Y location characteristics in internal flash.
CONFIG_FLASH=y
CONFIG_FLASH_MAP=y
CONFIG_NVS=y
CONFIG_SETTINGS=y
CONFIG_SETTINGS_NVS=y

# The Ranging Profile recommends a MTU of at least 247 octets.
CONFIG_BT_L2CAP_TX_MTU=498
CONFIG_BT_BUF_ACL_TX_SIZE=502
CONFIG_BT_BUF_ACL_RX_SIZE=502
CONFIG_BT_CTLR_DATA_LENGTH_MAX=251
CONFIG_BT_CTLR_PHY_2M=y

# Enable combined RTT/PBR mode-3 steps in the controller and RAS storage.
CONFIG_BT_RAS_MODE_3_SUPPORTED=y
CONFIG_BT_CTLR_SDC_CS_STEP_MODE3=y

# 160 mode-3 AA-only steps, four antenna paths: each step uses 27 bytes
# of data + 3 bytes of HCI step framing, totaling 4800 bytes.
# Revisit if enabling sounding-sequence packet PCTs.
CONFIG_BT_CHANNEL_SOUNDING_REASSEMBLY_BUFFER_SIZE=4800

# This allows CS and ACL to use different PHYs
CONFIG_BT_TRANSMIT_POWER_CONTROL=y

CONFIG_BT_CHANNEL_SOUNDING=y
CONFIG_BT_RAS=y
CONFIG_BT_RAS_RRSP=y
```

## src/main.c
```c
/*
 * Copyright (c) 2024 Nordic Semiconductor ASA
 *
 * SPDX-License-Identifier: MIT
 */

/** @file
 *  @brief Channel Sounding Reflector with Ranging Responder sample
 */

#if !defined(CONFIG_MARS_CS_INLINE_PCT)
#include <bluetooth/services/ras.h>
#endif  // !defined(CONFIG_MARS_CS_INLINE_PCT)
#include <dk_buttons_and_leds.h>
#include <zephyr/bluetooth/bluetooth.h>
#include <zephyr/bluetooth/conn.h>
#include <zephyr/bluetooth/cs.h>
#include <zephyr/bluetooth/uuid.h>
#include <zephyr/kernel.h>
#include <zephyr/logging/log.h>
#include <zephyr/sys/byteorder.h>
#include <zephyr/sys/reboot.h>

#include "antenna.h"
#include "cs_watchdog.h"
#include "location.h"

LOG_MODULE_REGISTER(app_main, LOG_LEVEL_INF);

/** @brief LED used to indicate an active BLE connection. */
#define CON_STATUS_LED DK_LED1

/** @brief Semaphore signaled when a BLE connection is established. */
static K_SEM_DEFINE(sem_connected, 0, 1);
/** @brief Semaphore signaled when CS config creation completes. */
static K_SEM_DEFINE(sem_config, 0, 1);

/** @brief Current BLE connection reference. */
static struct bt_conn * gp_connection;

/** @brief BLE advertising data — flags, device name, and (in RAS mode) Ranging Service UUID. */
#if IS_ENABLED(CONFIG_MARS_CS_INLINE_PCT)
static const struct bt_data ad[] = {
    BT_DATA_BYTES(BT_DATA_FLAGS, (BT_LE_AD_GENERAL | BT_LE_AD_NO_BREDR)),
    BT_DATA(BT_DATA_NAME_COMPLETE, CONFIG_BT_DEVICE_NAME, sizeof(CONFIG_BT_DEVICE_NAME) - 1),
};
#else   // IS_ENABLED(CONFIG_MARS_CS_INLINE_PCT)
static const struct bt_data ad[] = {
    BT_DATA_BYTES(BT_DATA_FLAGS, (BT_LE_AD_GENERAL | BT_LE_AD_NO_BREDR)),
    BT_DATA_BYTES(BT_DATA_UUID16_ALL, BT_UUID_16_ENCODE(BT_UUID_RANGING_SERVICE_VAL)),
    BT_DATA(BT_DATA_NAME_COMPLETE, CONFIG_BT_DEVICE_NAME, sizeof(CONFIG_BT_DEVICE_NAME) - 1),
};
#endif  // IS_ENABLED(CONFIG_MARS_CS_INLINE_PCT)

/** @brief Callback for BLE connection established — stores connection ref and lights LED. */
static void connected_cb(struct bt_conn * conn, uint8_t err)
{
    char addr[BT_ADDR_LE_STR_LEN];

    (void)bt_addr_le_to_str(bt_conn_get_dst(conn), addr, sizeof(addr));
    LOG_INF("Connected to %s (err 0x%02X)", addr, err);

    if (err)
    {
        bt_conn_unref(conn);
        gp_connection = NULL;
    }
    else
    {
        gp_connection = bt_conn_ref(conn);

        k_sem_give(&sem_connected);

        dk_set_led_on(CON_STATUS_LED);
    }
}

/** @brief Callback for BLE disconnection — reboots the device. */
static void disconnected_cb(struct bt_conn * conn, uint8_t reason)
{
    LOG_INF("Disconnected (reason 0x%02X)", reason);

    bt_conn_unref(conn);
    gp_connection = NULL;

    dk_set_led_off(CON_STATUS_LED);

    sys_reboot(SYS_REBOOT_COLD);
}

/** @brief Callback for CS remote capabilities exchange completion. */
static void remote_capabilities_cb(struct bt_conn * conn, uint8_t status, struct bt_conn_le_cs_capabilities * params)
{
    ARG_UNUSED(conn);

    if (status == BT_HCI_ERR_SUCCESS)
    {
        antenna_set_peer_count(params->num_antennas_supported);
        LOG_INF("CS capability exchange completed. (peer antennas: %u)", params->num_antennas_supported);
    }
    else
    {
        LOG_WRN("CS capability exchange failed. (HCI status 0x%02x)", status);
    }
}

/** @brief Callback for CS config creation — logs config details and signals semaphore. */
static void config_create_cb(struct bt_conn * conn, uint8_t status, struct bt_conn_le_cs_config * config)
{
    ARG_UNUSED(conn);

    if (status == BT_HCI_ERR_SUCCESS)
    {
        const char * mode_str[5]       = {"Unused", "1 (RTT)", "2 (PBR)", "3 (RTT + PBR)", "Invalid"};
        const char * role_str[3]       = {"Initiator", "Reflector", "Invalid"};
        const char * rtt_type_str[8]   = {"AA only",
                                          "32-bit sounding",
                                          "96-bit sounding",
                                          "32-bit random",
                                          "64-bit random",
                                          "96-bit random",
                                          "128-bit random",
                                          "Invalid"};
        const char * phy_str[4]        = {"Invalid", "LE 1M PHY", "LE 2M PHY", "LE 2M 2BT PHY"};
        const char * chsel_type_str[3] = {"Algorithm #3b", "Algorithm #3c", "Invalid"};
        const char * ch3c_shape_str[3] = {"Hat shape", "X shape", "Invalid"};

        uint8_t mode_idx       = config->mode > 0 && config->mode < 4 ? config->mode : 4;
        uint8_t role_idx       = MIN(config->role, 2);
        uint8_t rtt_type_idx   = MIN(config->rtt_type, 7);
        uint8_t phy_idx        = config->cs_sync_phy > 0 && config->cs_sync_phy < 4 ? config->cs_sync_phy : 0;
        uint8_t chsel_type_idx = MIN(config->channel_selection_type, 2);
        uint8_t ch3c_shape_idx = MIN(config->ch3c_shape, 2);

        LOG_INF(
            "CS config creation complete.\n"
            " - id: %u\n"
            " - mode: %s\n"
            " - min_main_mode_steps: %u\n"
            " - max_main_mode_steps: %u\n"
            " - main_mode_repetition: %u\n"
            " - mode_0_steps: %u\n"
            " - role: %s\n"
            " - rtt_type: %s\n"
            " - cs_sync_phy: %s\n"
            " - channel_map_repetition: %u\n"
            " - channel_selection_type: %s\n"
            " - ch3c_shape: %s\n"
            " - ch3c_jump: %u\n"
            " - t_ip1_time_us: %u\n"
            " - t_ip2_time_us: %u\n"
            " - t_fcs_time_us: %u\n"
            " - t_pm_time_us: %u\n"
            " - channel_map: 0x%08X%08X%04X\n",
            config->id,
            mode_str[mode_idx],
            config->min_main_mode_steps,
            config->max_main_mode_steps,
            config->main_mode_repetition,
            config->mode_0_steps,
            role_str[role_idx],
            rtt_type_str[rtt_type_idx],
            phy_str[phy_idx],
            config->channel_map_repetition,
            chsel_type_str[chsel_type_idx],
            ch3c_shape_str[ch3c_shape_idx],
            config->ch3c_jump,
            config->t_ip1_time_us,
            config->t_ip2_time_us,
            config->t_fcs_time_us,
            config->t_pm_time_us,
            sys_get_le32(&config->channel_map[6]),
            sys_get_le32(&config->channel_map[2]),
            sys_get_le16(&config->channel_map[0]));

        k_sem_give(&sem_config);
    }
    else
    {
        LOG_WRN("CS config creation failed. (HCI status 0x%02x)", status);
    }
}

/** @brief Callback for CS security enable completion. */
static void security_enable_cb(struct bt_conn * conn, uint8_t status)
{
    ARG_UNUSED(conn);

    if (status == BT_HCI_ERR_SUCCESS)
    {
        LOG_INF("CS security enabled.");
    }
    else
    {
        LOG_WRN("CS security enable failed. (HCI status 0x%02x)", status);
    }
}

/** @brief Callback for CS procedure enable completion — logs procedure parameters. */
static void procedure_enable_cb(struct bt_conn *                                 conn,
                                uint8_t                                          status,
                                struct bt_conn_le_cs_procedure_enable_complete * params)
{
    ARG_UNUSED(conn);

    if (status == BT_HCI_ERR_SUCCESS)
    {
        if (params->state == 1)
        {
            LOG_INF(
                "CS procedures enabled:\n"
                " - config ID: %u\n"
                " - antenna configuration index: %u\n"
                " - TX power: %d dbm\n"
                " - subevent length: %u us\n"
                " - subevents per event: %u\n"
                " - subevent interval: %u\n"
                " - event interval: %u\n"
                " - procedure interval: %u\n"
                " - procedure count: %u\n"
                " - maximum procedure length: %u",
                params->config_id,
                params->tone_antenna_config_selection,
                params->selected_tx_power,
                params->subevent_len,
                params->subevents_per_event,
                params->subevent_interval,
                params->event_interval,
                params->procedure_interval,
                params->procedure_count,
                params->max_procedure_len);
        }
        else
        {
            LOG_INF("CS procedures disabled.");
        }
    }
    else
    {
        LOG_WRN("CS procedures enable failed. (HCI status 0x%02x)", status);
    }
}

BT_CONN_CB_DEFINE(conn_cb) = {
    .connected                               = connected_cb,
    .disconnected                            = disconnected_cb,
    .le_cs_read_remote_capabilities_complete = remote_capabilities_cb,
    .le_cs_config_complete                   = config_create_cb,
    .le_cs_security_enable_complete          = security_enable_cb,
    .le_cs_procedure_enable_complete         = procedure_enable_cb,
};

/** @brief Fallback reboot if the watchdog's forced disconnect never completes. */
static void reboot_fallback_handler(struct k_timer * timer)
{
    ARG_UNUSED(timer);

    sys_reboot(SYS_REBOOT_COLD);
}

static K_TIMER_DEFINE(reboot_fallback, reboot_fallback_handler, NULL);

/**
 * @brief CS liveness watchdog pet source (#116).
 *
 * Pets only on subevents that COMPLETED with step data — the mirror of the
 * initiator's step accumulation (aborted subevents are discarded there). The
 * RRSP's RD-ready notify is NOT a liveness signal: it fires on procedures
 * whose subevents all aborted, which is exactly the storm signature.
 */
static void cs_watchdog_subevent_cb(struct bt_conn * conn, struct bt_conn_le_cs_subevent_result * result)
{
    ARG_UNUSED(conn);

    if (result->header.subevent_done_status == BT_CONN_LE_CS_SUBEVENT_ABORTED)
    {
        /* Desk observability for the #116 root-cause follow-up: the LL abort
         * reasons (NO_CS_SYNC vs SCHED_CONFLICT) are invisible on the rig. */
        LOG_WRN(
            "CS subevent aborted: proc=%u sub_abort_reason=%u proc_abort_reason=%u "
            "nsteps=%u abort_step=%u",
            result->header.procedure_counter,
            result->header.subevent_abort_reason,
            result->header.procedure_abort_reason,
            result->header.num_steps_reported,
            result->header.abort_step);
        return;
    }

    if (result->header.subevent_done_status == BT_CONN_LE_CS_SUBEVENT_COMPLETE && result->header.num_steps_reported > 0)
    {
        cs_watchdog_pet();
    }
}

BT_CONN_CB_DEFINE(cs_watchdog_conn_cb) = {
    .le_cs_subevent_data_available = cs_watchdog_subevent_cb,
};

/**
 * @brief Recover stalled ranging on a dedicated worker thread.
 *
 * Disconnect to trigger a reboot. Arm a 2 s fallback first so a blocked
 * disconnect cannot prevent a reboot.
 */
static void cs_watchdog_recovery_cb(void)
{
    /* Arm before the synchronous HCI command, which may never return. */
    k_timer_start(&reboot_fallback, K_MSEC(2000), K_NO_WAIT);

    if (gp_connection != NULL && bt_conn_disconnect(gp_connection, BT_HCI_ERR_LOCALHOST_TERM_CONN) == 0)
    {
        return;
    }

    sys_reboot(SYS_REBOOT_COLD);
}

int main(void)
{
    int err;

    LOG_INF("Starting Mars Channel Sounding Reflector");

    dk_leds_init();

    err = bt_enable(NULL);
    if (err)
    {
        LOG_ERR("Bluetooth init failed (err %d)", err);
        return 0;
    }

    /* CS liveness watchdog (#116): inert until the first completed subevent
     * with step data pets it, so the handshake never false-triggers it. */
    cs_watchdog_init(cs_watchdog_recovery_cb);

    err = location_init();
    if (err)
    {
        LOG_ERR("Location storage init failed (err %d)", err);
        return 0;
    }

    err = bt_le_adv_start(BT_LE_ADV_CONN_FAST_2, ad, ARRAY_SIZE(ad), NULL, 0);
    if (err)
    {
        LOG_ERR("Advertising failed to start (err %d)", err);
        return 0;
    }

    while (true)
    {
        k_sem_take(&sem_connected, K_FOREVER);

        const struct bt_le_cs_set_default_settings_param default_settings = {
            .enable_initiator_role     = false,
            .enable_reflector_role     = true,
            .cs_sync_antenna_selection = BT_LE_CS_ANTENNA_SELECTION_OPT_REPETITIVE,
            .max_tx_power              = BT_HCI_OP_LE_CS_MAX_MAX_TX_POWER,
        };

        err = bt_le_cs_set_default_settings(gp_connection, &default_settings);
        if (err)
        {
            LOG_ERR("Failed to configure default CS settings (err %d)", err);
            return 0;
        }

#if IS_ENABLED(CONFIG_MARS_CS_INLINE_PCT)
        /*
         * IPT mode: the connected central device performs the rest of the CS
         * setup (config creation, security enable, procedure parameters and
         * enable). The reflector does not set procedure parameters or expose
         * the Ranging Service. The reflector reboots on disconnect, so the
         * outer loop simply re-waits for the next connection (moot in normal
         * operation but kept for symmetry with the RAS path).
         */
        continue;
#else   // IS_ENABLED(CONFIG_MARS_CS_INLINE_PCT)
        k_sem_take(&sem_config, K_FOREVER);

        const uint8_t ANTENNA_CONFIG         = antenna_get_config_for_role(BT_CONN_LE_CS_ROLE_REFLECTOR);
        const uint8_t PREFERRED_PEER_ANTENNA = antenna_get_peer_mask();

        LOG_INF("Local antennas: %d, paths: %d, using config: %d, preferred peer antenna: %d",
                CONFIG_BT_CTLR_SDC_CS_NUM_ANTENNAS,
                CONFIG_BT_CTLR_SDC_CS_MAX_ANTENNA_PATHS,
                ANTENNA_CONFIG,
                PREFERRED_PEER_ANTENNA);

        /* The subevent length suggestions deliberately span the full usable
         * spec range (1250–75000 us; 1250 is the HCI-specified floor, see
         * zephyr/include/zephyr/bluetooth/cs.h) so that any subevent length
         * the initiator computes from its negotiated config intersects this
         * window. */
        const struct bt_le_cs_set_procedure_parameters_param procedure_params = {
            .config_id                     = 0,
            .max_procedure_len             = 1000,
            .min_procedure_interval        = 1,
            .max_procedure_interval        = 100,
            .max_procedure_count           = 0,
            .min_subevent_len              = 1250,
            .max_subevent_len              = 75000,
            .tone_antenna_config_selection = ANTENNA_CONFIG,
            .phy                           = BT_LE_CS_PROCEDURE_PHY_2M,
            .tx_power_delta                = 0x80,
            .preferred_peer_antenna        = PREFERRED_PEER_ANTENNA,
            .snr_control_initiator         = BT_LE_CS_SNR_CONTROL_NOT_USED,
            .snr_control_reflector         = BT_LE_CS_SNR_CONTROL_NOT_USED,
        };

        err = bt_le_cs_set_procedure_parameters(gp_connection, &procedure_params);
        if (err)
        {
            LOG_ERR("Failed to set procedure parameters (err %d)", err);
            return 0;
        }
#endif  // IS_ENABLED(CONFIG_MARS_CS_INLINE_PCT)
    }

    return 0;
}
```

## src/location.c
```c
/* SPDX-License-Identifier: MIT */

#include "location.h"

#include <errno.h>
#include <stdint.h>
#include <stdio.h>
#include <string.h>
#include <zephyr/bluetooth/gatt.h>
#include <zephyr/kernel.h>
#include <zephyr/logging/log.h>
#include <zephyr/settings/settings.h>
#include <zephyr/sys/byteorder.h>

LOG_MODULE_REGISTER(reflector_location, LOG_LEVEL_INF);

/* Coordinates are signed millimetres, exposed as decimal UTF-8 text for phone apps. */
#define LOCATION_UUID(value) BT_UUID_128_ENCODE(value, 0x7ea1, 0x4b73, 0x9bb1, 0x6f54940c3a10)
#define LOCATION_TEXT_SIZE   12 /* -2147483648 plus terminator */

static int32_t            coordinates[2];
static const char * const setting_keys[] = {"location/x", "location/y"};
static K_MUTEX_DEFINE(location_lock);

static int location_settings_set(const char * name, size_t len, settings_read_cb read_cb, void * cb_arg)
{
    int     axis;
    uint8_t stored[sizeof(int32_t)];

    if (strcmp(name, "x") == 0)
    {
        axis = 0;
    }
    else if (strcmp(name, "y") == 0)
    {
        axis = 1;
    }
    else
    {
        return -ENOENT;
    }

    if (len != sizeof(stored))
    {
        return -EINVAL;
    }

    int rc = read_cb(cb_arg, stored, sizeof(stored));
    if (rc < 0)
    {
        return rc;
    }
    if (rc != sizeof(stored))
    {
        return -EIO;
    }

    coordinates[axis] = (int32_t)sys_get_le32(stored);
    return 0;
}

SETTINGS_STATIC_HANDLER_DEFINE(location, "location", NULL, location_settings_set, NULL, NULL);

static ssize_t read_coordinate(
    struct bt_conn * conn, const struct bt_gatt_attr * attr, void * buf, uint16_t len, uint16_t offset)
{
    char            text[LOCATION_TEXT_SIZE];
    const int32_t * coordinate = attr->user_data;

    k_mutex_lock(&location_lock, K_FOREVER);
    int size = snprintf(text, sizeof(text), "%ld", (long)*coordinate);
    k_mutex_unlock(&location_lock);

    return bt_gatt_attr_read(conn, attr, buf, len, offset, text, size);
}

static ssize_t write_coordinate(struct bt_conn *            conn,
                                const struct bt_gatt_attr * attr,
                                const void *                buf,
                                uint16_t                    len,
                                uint16_t                    offset,
                                uint8_t                     flags)
{
    ARG_UNUSED(conn);
    const uint8_t * text       = buf;
    int32_t *       coordinate = attr->user_data;
    bool            negative   = len > 0 && text[0] == '-';
    uint16_t        start      = negative ? 1 : 0;
    uint32_t        magnitude  = 0;
    uint32_t        limit      = negative ? (uint32_t)INT32_MAX + 1U : INT32_MAX;

    if (flags & BT_GATT_WRITE_FLAG_PREPARE)
    {
        return BT_GATT_ERR(BT_ATT_ERR_WRITE_NOT_PERMITTED);
    }
    if (offset != 0)
    {
        return BT_GATT_ERR(BT_ATT_ERR_INVALID_OFFSET);
    }
    if (len <= start || len >= LOCATION_TEXT_SIZE)
    {
        return BT_GATT_ERR(BT_ATT_ERR_INVALID_ATTRIBUTE_LEN);
    }
    for (uint16_t i = start; i < len; i++)
    {
        if (text[i] < '0' || text[i] > '9')
        {
            return BT_GATT_ERR(BT_ATT_ERR_VALUE_NOT_ALLOWED);
        }
        uint32_t digit = text[i] - '0';
        if (magnitude > (limit - digit) / 10U)
        {
            return BT_GATT_ERR(BT_ATT_ERR_VALUE_NOT_ALLOWED);
        }
        magnitude = magnitude * 10U + digit;
    }

    int32_t value = negative ? (int32_t)(-(int64_t)magnitude) : (int32_t)magnitude;
    uint8_t stored[sizeof(value)];
    sys_put_le32((uint32_t)value, stored);

    /* Only acknowledge a write once it is durable; a failed save leaves RAM unchanged. */
    k_mutex_lock(&location_lock, K_FOREVER);
    int err = settings_save_one(setting_keys[coordinate - coordinates], stored, sizeof(stored));
    if (err == 0)
    {
        *coordinate = value;
    }
    k_mutex_unlock(&location_lock);
    if (err)
    {
        LOG_ERR("Coordinate save failed (err %d)", err);
        return BT_GATT_ERR(BT_ATT_ERR_UNLIKELY);
    }

    return len;
}

BT_GATT_SERVICE_DEFINE(location_service,
                       BT_GATT_PRIMARY_SERVICE(BT_UUID_DECLARE_128(LOCATION_UUID(0xa00c0000))),
                       BT_GATT_CHARACTERISTIC(BT_UUID_DECLARE_128(LOCATION_UUID(0xa00c0001)),
                                              BT_GATT_CHRC_READ | BT_GATT_CHRC_WRITE,
                                              BT_GATT_PERM_READ | BT_GATT_PERM_WRITE,
                                              read_coordinate,
                                              write_coordinate,
                                              &coordinates[0]),
                       BT_GATT_CUD("x", BT_GATT_PERM_READ),
                       BT_GATT_CHARACTERISTIC(BT_UUID_DECLARE_128(LOCATION_UUID(0xa00c0002)),
                                              BT_GATT_CHRC_READ | BT_GATT_CHRC_WRITE,
                                              BT_GATT_PERM_READ | BT_GATT_PERM_WRITE,
                                              read_coordinate,
                                              write_coordinate,
                                              &coordinates[1]),
                       BT_GATT_CUD("y", BT_GATT_PERM_READ));

int location_init(void)
{
    int err = settings_subsys_init();
    if (err)
    {
        return err;
    }

    return settings_load();
}
```

## src/location.h
```c
/* SPDX-License-Identifier: MIT */
#ifndef REFLECTOR_LOCATION_H_
#define REFLECTOR_LOCATION_H_

/** Initialize persistent coordinates before starting advertising. */
int location_init(void);

#endif
```
